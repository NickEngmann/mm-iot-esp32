## examples/scan/sdkconfig.defaults.esp32s3
```kconfig
#
# ESP32S3-specific
#
CONFIG_MM_RESET_N=1
CONFIG_MM_WAKE=2
CONFIG_MM_BUSY=5
CONFIG_MM_SPI_SCK=7
CONFIG_MM_SPI_MOSI=9
CONFIG_MM_SPI_MISO=8
CONFIG_MM_SPI_CS=4
CONFIG_MM_SPI_IRQ=3
CONFIG_MM_BCF_FILE="bcf_fgh100mhaamd.mbin"
CONFIG_MM_FW_FILE="mm6108.mbin"

CONFIG_MMPKTMEM_TX_POOL_N_BLOCKS=8
CONFIG_MMPKTMEM_RX_POOL_N_BLOCKS=8
CONFIG_ESP32S3_INSTRUCTION_CACHE_32KB=y
```

## examples/sta_connect/sdkconfig.defaults
```kconfig
CONFIG_FREERTOS_HZ=1000

CONFIG_IDF_TARGET="esp32c3"

CONFIG_MBEDTLS_NIST_KW_C=y
```

## examples/station_http_client/sdkconfig.defaults.esp32c3
```kconfig
#
# ESP32C3-specific
#

CONFIG_MM_RESET_N=2
CONFIG_MM_WAKE=3
CONFIG_MM_BUSY=6
CONFIG_MM_SPI_SCK=8
CONFIG_MM_SPI_MOSI=10
CONFIG_MM_SPI_MISO=9
CONFIG_MM_SPI_CS=5
CONFIG_MM_SPI_IRQ=4
CONFIG_MM_BCF_FILE="bcf_fgh100mhaamd.mbin"
CONFIG_MM_FW_FILE="mm6108.mbin"

CONFIG_MMPKTMEM_TX_POOL_N_BLOCKS=8
CONFIG_MMPKTMEM_RX_POOL_N_BLOCKS=8
```
